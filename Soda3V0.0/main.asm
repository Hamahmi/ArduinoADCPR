;
; Soda3V0.0.asm
;
; Created: 09-Nov-18 4:32:38 PM
; Author : Embedded???? ?? ??? ?? 
;

;		A		B		C
; PIN	20		23		26
; DDR	21		24		27
; PORT	22		25		28

; ADCSRA	7A
; ADMUX		7C
; ADCL		78
; ADCH		79


; VALUES
;	PORTC 7 -> D30 ---> LED 
;	PORTB 7 -> INTERNAL LED
;	

; Start of the code

// INTERNAL LED IS USED ONLY FOR DEBUGGING PURPOSES IN ORDER IF LED IS BURNED

LDI R16 , 0x00		
STS 0x21, R16	; DDRA	A INPUT  FOR ADC 
LDI R16 , 0xFF
STS 0x27, R16	; DDRC	C OUTPUT FOR LED
STS 0x24, R16	; DDRB  B OUTPUT FOR INTERNAL LED
STS 0x22, R16	; PORTA A IS INPUT WITH PULL UP RESISTORS
LDI R16 , 0x87	
STS 0x7A, R16	; ADCSRA -> ENABLE ADC AND CLK/128
LDI R16 , 0xC0
STS 0x7C, R16	; ADMUX	 -> 2.56 VREF, ADC0 SIGNAL ENDED INPUT, ADCH[1,0]:ADCL



READ_ADC:
	LDS	R16, 0x7A ; ADCSRA									// SBI ADCSRA, ADSC
	SBR R16, 0b01000000										// SBI ADCSRA, ADSC
	STS 0x7A, R16	; ADSC		START CONVERSION			// SBI ADCSRA, ADSC

	KEEP_POLING :
		LDS R16 ,0x7A	;									//	SBIS ADCSRA, ADIF  
		SBRS R16, 4		; ADIF	WAIT TILL CONVERSION ENDS	//	SBIS ADCSRA, ADIF
		JMP KEEP_POLING
	LDS R16, 0x7A											// SBI ADCSRA, 4
	SBR R16, 0b00010000										// SBI ADCSRA, 4
	STS 0x7A, R16		; ADIF	CLEAR ADIF FLAG				// SBI ADCSRA, 4
	
	LDS R16 , 0x78	; ADCL		READ ADCL
	// DO NOT REALLY NEAD ADCL 
	LDS R16 , 0x79	; ADCH		READ ADCH
	SBRS R16 , 0	; SET THRESHOLD
	JMP ZERO		; DARK
	SBRS R16 , 1	; SET THRESHOLD
	JMP ZERO		; DARK
	JMP ONE			; LIGHT

	
	
ZERO :
	SBI PORTC , 7	; TURN LED ON
	SBI PORTB , 7	; TURN INTERNAL LED ON
	JMP READ_ADC	; KEEP READING

ONE : 
	CBI PORTC , 7	; TURN LED OFF
	CBI PORTB , 7	; TURN INTERNAL LED OFF
	JMP READ_ADC	; KEEP READING